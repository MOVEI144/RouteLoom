## artifacts/hil/2026-10-01-stab-fix/radio-probe/source/sdkconfig.defaults
```kconfig
CONFIG_ESPTOOLPY_FLASHSIZE_4MB=y
CONFIG_PARTITION_TABLE_CUSTOM=y
CONFIG_PARTITION_TABLE_CUSTOM_FILENAME="partitions.csv"
CONFIG_ESP_CONSOLE_USB_SERIAL_JTAG=y
CONFIG_COMPILER_OPTIMIZATION_SIZE=y
```

## components/routeloom/Kconfig
```kconfig
menu "RouteLoom"

    config ROUTELOOM_TRACE
        bool "Periodic Owner trace logs"
        default n
        help
            Logs the periodic diagnostics that otherwise cost console time
            on every node: the stack high-water mark and Owner counters
            once a minute, the member/authority counters every 5 s and the
            bridge USB counters every 2 s. Off in field images.

    config ROUTELOOM_HIL_TRACE_LINK_EPOCHS
        bool "HIL trace of link context IDs and RLD1 handshake steps"
        default n
        help
            Bench-only diagnostic logs for reset recovery. Context IDs and
            handshake step numbers are logged, never keys or payloads.

    config ROUTELOOM_HIL_HEAP_TELEMETRY
        bool "HIL free heap and largest block once per minute"
        default n
        help
            Bench-only heap samples beside the existing stack high-water log.
            Logs free, largest and minimum free 8-bit heap in bytes so a
            long hardware run can detect leaks and fragmentation. Also logs
            aggregate neighbor-discovery counts for route diagnosis.

    config ROUTELOOM_HIL_EDHOC_TIMING
        bool "HIL timings for EDHOC P-256 operations and full exchange"
        default n
        help
            Logs operation durations and the full handshake duration on an
            ESP bench. No key, transcript or payload bytes are logged.

    config ROUTELOOM_HIL_LR250_TELEMETRY
        bool "HIL log of the ESP-NOW LR250 driver rate call"
        default n
        help
            Logs the status returned by esp_now_set_peer_rate_config for
            each peer registration. This proves driver acceptance; air-rate
            confirmation still requires an independent sniffer.

    config ROUTELOOM_HIL_DROP_RX_MAC
        string "HIL drop frames received from one peer MAC (empty disables)"
        default ""
        help
            Bench-only one-hop topology control. Set a 17-character colon
            separated MAC address to discard that sender's ESP-NOW frames
            before discovery and Wire processing. Use paired images to
            prevent a direct BIND and force a relay path. Empty by default.

    config ROUTELOOM_WIFI_NETIF_INIT
        bool "Start esp_netif (lwIP TCP/IP task) before the Wi-Fi driver"
        default n
        help
            ESP-NOW needs the Wi-Fi driver and the default event loop only.
            esp_netif_init() additionally starts the lwIP TCP/IP task and
            its mailboxes, which cost boot heap on ESP32-C3 gateways that
            never use IP networking. Enable only for firmware that also
            runs esp_netif/lwIP.

    config ROUTELOOM_BOOT_HEAP_FLOOR_BYTES
        int "Boot heap floor after ESP-NOW start (bytes, 0 disables)"
        range 0 262144
        default 8192
        help
            After Wi-Fi, PHY and ESP-NOW are up the runtime logs the free
            internal heap and its largest block. Below this floor it logs
            the BOOT_HEAP_BELOW_FLOOR error (the node keeps running); the
            HIL harness treats that line as a failed start. The static-RAM
            guard in CI (tools/firmware_ram_report.py) models the same
            figure from measured per-target offsets; this is the on-device
            check of the real number (docs/design/sdk-v1/ram-budget.md).

    choice ROUTELOOM_RESOURCE_PROFILE
        prompt "Resource profile"
        default ROUTELOOM_RESOURCE_PROFILE_RELAY
        help
            Compile-time capacities of the Owner, MeshNode and USB bridge
            (include/routeloom/profile.hpp). The end-session count is the
            number of peers holding a live end-to-end key at once, not the
            mesh size: a full table evicts the oldest idle context and
            RLRES1 restores it on the next send.

        config ROUTELOOM_RESOURCE_PROFILE_ENDPOINT
            bool "endpoint (8 end sessions, 16 routes, no join relay or USB)"
        config ROUTELOOM_RESOURCE_PROFILE_RELAY
            bool "relay (8 end sessions, no join relay gateway or USB)"
        config ROUTELOOM_RESOURCE_PROFILE_GATEWAY_SMALL
            bool "gateway_small (64 end sessions; ESP32-C3 gateway)"
        config ROUTELOOM_RESOURCE_PROFILE_GATEWAY
            bool "gateway (128 end sessions)"
        config ROUTELOOM_RESOURCE_PROFILE_FULL
            bool "full (every table at its maximum; host tests)"
    endchoice

    config ROUTELOOM_RESOURCE_PROFILE_ID
        int
        default 1 if ROUTELOOM_RESOURCE_PROFILE_ENDPOINT
        default 3 if ROUTELOOM_RESOURCE_PROFILE_GATEWAY_SMALL
        default 4 if ROUTELOOM_RESOURCE_PROFILE_GATEWAY
        default 5 if ROUTELOOM_RESOURCE_PROFILE_FULL
        default 2

    choice ROUTELOOM_ROLE
        prompt "Device role"
        default ROUTELOOM_ROLE_RELAY
        help
            The role this image runs. A role above the resource profile
            (a gateway on a relay or endpoint profile, a relay on an
            endpoint profile) is refused before RF starts with
            RESOURCE_PROFILE_ROLE_MISMATCH.

        config ROUTELOOM_ROLE_ENDPOINT
            bool "endpoint"
        config ROUTELOOM_ROLE_RELAY
            bool "relay"
        config ROUTELOOM_ROLE_GATEWAY
            bool "gateway (USB-attached)"
    endchoice

    config ROUTELOOM_ROLE_ID
        int
        default 1 if ROUTELOOM_ROLE_ENDPOINT
        default 3 if ROUTELOOM_ROLE_GATEWAY
        default 2

    choice ROUTELOOM_DEDUP_PROFILE
        prompt "Dedup capacity"
        default ROUTELOOM_DEDUP_PROFILE_DEFAULT
        help
            Compile-time capacity of the node's duplicate-suppression pool
            (docs/reference/resource-profiles.json dedup_entries). Each record
            is 136 bytes of static RAM inside MeshNode (the budget allows 152).
            Terminal pins may use at most 7/8 of the pool; a relay's transit
            records are held only for the frame's own deadline plus a short
            slack. The resource profile sets the default (32 for endpoint and
            gateway_small, 96 otherwise); the other entries pin a size per
            image. Static RAM per role: docs/design/sdk-v1/ram-budget.md.

        config ROUTELOOM_DEDUP_PROFILE_DEFAULT
            bool "resource profile default"
        config ROUTELOOM_DEDUP_PROFILE_LEAF
            bool "leaf-small (32 records)"
        config ROUTELOOM_DEDUP_PROFILE_RELAY
            bool "relay-c3 (96 records)"
        config ROUTELOOM_DEDUP_PROFILE_GATEWAY
            bool "gateway-s3 (256 records)"
    endchoice

    config ROUTELOOM_DEDUP_CAPACITY
        int
        default 32 if ROUTELOOM_DEDUP_PROFILE_LEAF
        default 96 if ROUTELOOM_DEDUP_PROFILE_RELAY
        default 256 if ROUTELOOM_DEDUP_PROFILE_GATEWAY
        default 0

    menu "USB bridge optional features"
        depends on ROUTELOOM_RESOURCE_PROFILE_GATEWAY_SMALL || ROUTELOOM_RESOURCE_PROFILE_GATEWAY || ROUTELOOM_RESOURCE_PROFILE_FULL

        config ROUTELOOM_USB_NODE_STATUS
            bool "node_status_v1 (HostOps 0x40-0x42)"
            default n if ROUTELOOM_RESOURCE_PROFILE_GATEWAY_SMALL
            default y
            help
                Per-node link/route tracking for the 0x40 pages and 0x42
                events. Off: attach_node_status() answers Unsupported and
                capability bit 6 is never advertised.

        config ROUTELOOM_USB_GATEWAY_ENDPOINT
            bool "gateway_endpoint_v1 and config_endpoint_v1 (HostOps 0x10-0x25)"
            default n if ROUTELOOM_RESOURCE_PROFILE_GATEWAY_SMALL
            default y
            help
                Host registration, ingress and remote-gateway send slots of
                the explicit gateway endpoint, and the routed config lane.
                Off: attach_gateway()/attach_config() answer Unsupported and
                capability bits 3-4 are never advertised.

        config ROUTELOOM_USB_GROUP
            bool "group_delivery_v1 (HostOps 0x50-0x52)"
            default y

        config ROUTELOOM_USB_OBSERVATION
            bool "observation_v1 (HostOps 0x70-0x72)"
            default y
    endmenu

    choice ROUTELOOM_SECURITY_MODE
        prompt "Security owner profile"
        default ROUTELOOM_SECURITY_MODE_DEV_RAM
        help
            Exclusive session-security profile (G-SEC P4 §8.4). The
            reference, bridge and example entries share one
            EspNowSecurityOwner. DevRam is the development default
            (RAM-only provider, no NVS counter/replay writes); MemberEdhoc
            is the production candidate.

        config ROUTELOOM_SECURITY_MODE_DEV_RAM
            bool "dev-ram (pairwise RAM sessions, no identity claim)"
        config ROUTELOOM_SECURITY_MODE_MEMBER_EDHOC
            bool "member-edhoc (EDHOC membership via the security owner)"
    endchoice

    config ROUTELOOM_APP_OBJECT_TRANSFER
        bool "Authenticated unicast application objects (4 KiB)"
        default n
        help
            Explicit object sends use Bulk priority and two outstanding chunks.
            Ordinary sends keep their existing payload limit. Applications
            provide the receive buffer and retain the immutable transmit loan.

    config ROUTELOOM_APP_OBJECT_RX_SLOTS
        int "Application object receive slots"
        depends on ROUTELOOM_APP_OBJECT_TRANSFER
        range 1 1 if IDF_TARGET_ESP32C3
        range 1 2
        default 1 if IDF_TARGET_ESP32C3
        default 2

endmenu
```

## examples/espnow_node/main/Kconfig.projbuild
```kconfig
menu "RouteLoom example"

config EXAMPLE_DESTINATION
    hex "Node ID the example greets once a minute (0 = receive only)"
    default 0x0

endmenu
```

## firmware/bench_node/main/Kconfig.projbuild
```kconfig
menu "RouteLoom bench node"

config ROUTELOOM_BENCH_CONTROLLER
    hex "Bench controller Node ID; 0 = first route gateway"
    default 0x0
    help
        Management commands (FAULT_SET, COUNTER_RESET, RESET_REQUEST,
        PEER_SEND_START) are accepted only from this origin. 0 binds the
        controller to the first route gateway once the scoped uplink
        installs. Not a production identity claim — dev bench only.

endmenu
```

## firmware/reference_node/main/Kconfig.projbuild
```kconfig
menu "RouteLoom reference node"

config ROUTELOOM_HIL_SEND_DESTINATION
    hex "HIL-only device-originated unicast destination (0 disables)"
    default 0x0
    help
        Bench-only application traffic emitted by this reference node after
        boot. Keep at zero for normal images. The receiver console records
        the origin, so a device-to-device path can be tested without USB.

config ROUTELOOM_HIL_SEND_COUNT
    int "HIL-only device-originated unicast attempts"
    range 0 100
    default 0
    depends on ROUTELOOM_HIL_SEND_DESTINATION != 0

config ROUTELOOM_HIL_GATEWAY_SEND_COUNT
    int "HIL-only explicit gateway sends (0 disables)"
    range 0 100
    default 0
    depends on ROUTELOOM_SECURITY_MODE_DEV_RAM || ROUTELOOM_SECURITY_MODE_MEMBER_EDHOC
    help
        Bench-only: 20 s after boot the node resolves the named gateway
        (GATEWAY_SDK_RAM) through Device::gateway() and sends this many
        explicit gateway messages, one every 3 s, logging each terminal
        state. Afterwards it resolves ROUTELOOM_HIL_GATEWAY_WRONG, which
        holds no gateway role, and logs that outcome. Keep at zero.

config ROUTELOOM_HIL_GATEWAY_ID
    hex "HIL-only explicit gateway NodeId"
    default 0x1
    depends on ROUTELOOM_HIL_GATEWAY_SEND_COUNT != 0

config ROUTELOOM_HIL_GATEWAY_WRONG
    hex "HIL-only NodeId without a gateway role (negative resolve, 0 skips)"
    default 0x0
    depends on ROUTELOOM_HIL_GATEWAY_SEND_COUNT != 0

endmenu
```
